## config/west.yml
```yaml
manifest:
  defaults:
    revision: v0.3
  remotes:
    - name: zmkfirmware
      url-base: https://github.com/zmkfirmware
    - name: petejohanson
      url-base: https://github.com/petejohanson/
    - name: caksoylar
      url-base: https://github.com/caksoylar
    - name: geeksville
      url-base: https://github.com/geeksville
    - name: urob
      url-base: https://github.com/urob
  projects:
    - name: zmk
      remote: zmkfirmware
      import: app/west.yml
    - name: cirque-input-module
      remote: geeksville
      revision: toucan
    - name: zmk-rgbled-widget
      remote: caksoylar
      revision: v0.3
    - name: zmk-helpers
      remote: urob
      revision: v0.3
    - name: zmk-auto-layer
      remote: urob
      revision: dfa7c695ffde41ef8064245453595d50e198ae1d
    - name: zmk-adaptive-key
      remote: urob
      revision: 18cc2795a64ccb394d1a7b7d591a5bfe3f25924b
  self:
    path: config
```
