## boards/shields/toucan36/Kconfig.defconfig
```kconfig
if SHIELD_TOUCAN36_LEFT

config ZMK_KEYBOARD_NAME
    default "Toucan36"

config ZMK_SPLIT_ROLE_CENTRAL
    default y

config ZMK_SPLIT_BLE_CENTRAL_BATTERY_LEVEL_FETCHING
    default y

config ZMK_SPLIT_BLE_CENTRAL_BATTERY_LEVEL_PROXY
    default y

endif



if SHIELD_TOUCAN36_LEFT || SHIELD_TOUCAN36_RIGHT

config SPI
    default y

config ZMK_SPLIT
    default y

config ZMK_POINTING
    default y

config RGBLED_WIDGET_BATTERY_LEVEL_HIGH
    default 40

endif
```

## boards/shields/toucan36/Kconfig.shield
```kconfig
config SHIELD_TOUCAN36_LEFT
    def_bool $(shields_list_contains,toucan36_left)

config SHIELD_TOUCAN36_RIGHT
    def_bool $(shields_list_contains,toucan36_right)
```
